## app/boards/shields/mousetrap/Kconfig.defconfig
```kconfig
# Copyright (c) 2020 Pete Johanson, Richard Jones
# SPDX-License-Identifier: MIT

if SHIELD_MOUSETRAP

config ZMK_KEYBOARD_NAME
	default "Mousetrap"

endif
```

## app/boards/shields/splitmouse/Kconfig.shield
```kconfig
# Copyright (c) 2020 Pete Johanson
# SPDX-License-Identifier: MIT

config SHIELD_SPLITMOUSE_LEFT
	def_bool $(shields_list_contains,splitmouse_left)

config SHIELD_SPLITMOUSE_RIGHT
	def_bool $(shields_list_contains,splitmouse_right)
```

## app/drivers/sensor/adns5030/Kconfig
```kconfig
# Copyright (c) 2020 The ZMK Contributors
# SPDX-License-Identifier: MIT

menuconfig ADNS5030
	bool "ADNS5030 Optical Sensor"
	depends on SPI
	help
	  Enable driver for ADNS5030 optical sensors.
```

## app/drivers/zephyr/dts/bindings/sensor/avago,adns5030.yaml
```yaml
description: |
  Sensor driver for the Avago ADNS5030 optical sensor

compatible: "avago,adns5030"

include: spi-device.yaml

properties:
  reg:
    required: true
    
  label:
    type: string
    required: true
```
